## nrf52833dk/Kconfig/Kconfig.shield
```kconfig
osource "c:/Users/Ryland/Documents/NCS_Projects/boards/shields/*/Kconfig.shield"
osource "C:/ncs/v2.3.0/nrf/boards/shields/*/Kconfig.shield"
```

## nrf52833dk/Kconfig/Kconfig.shield.defconfig
```kconfig
osource "c:/Users/Ryland/Documents/NCS_Projects/boards/shields/*/Kconfig.defconfig"
osource "C:/ncs/v2.3.0/nrf/boards/shields/*/Kconfig.defconfig"
```
